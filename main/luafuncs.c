
#include <lauxlib.h>
#include <lualib.h>
#include <lua.h>
#include <stdlib.h>
#include <stdint.h>
#include <string.h>
#include "esp_log.h"
#include "esp_timer.h"
#include "esp_http_client.h"
#include "freertos/FreeRTOS.h"
#include "freertos/task.h"
#include "display.h"
#include "luamatrix_mqtt.h"

static const char* TAG = "luafuncs";

#define LOCAL_LUA_INTEGER 1
#define LOCAL_LUA_NUMBER 2
#define LOCAL_LUA_STRING 3

// Static error buffer for argument errors
static char s_arg_error[128];

// Get typename for our arg types
static const char *get_argtype_name(int argtype) {
    switch(argtype) {
        case LOCAL_LUA_INTEGER: return "integer";
        case LOCAL_LUA_NUMBER: return "number";
        case LOCAL_LUA_STRING: return "string";
        default: return "unknown";
    }
}

// Returns 0 on success, 1 on error (with s_arg_error populated)
static int get_lua_arg(lua_State *LUA, int argno, int argtype, void *out) {
    int nargs = lua_gettop(LUA);
    if (argno > nargs) {
        snprintf(s_arg_error, sizeof(s_arg_error),
                 "arg #%d: expected %s, got nothing (only %d args)",
                 argno, get_argtype_name(argtype), nargs);
        return 1;
    }
    switch(argtype) {
        case LOCAL_LUA_INTEGER:
            if (!lua_isinteger(LUA, argno)) {
                snprintf(s_arg_error, sizeof(s_arg_error),
                         "arg #%d: expected integer, got %s",
                         argno, luaL_typename(LUA, argno));
                return 1;
            }
            *(int *)out = lua_tointeger(LUA, argno);
            break;
        case LOCAL_LUA_NUMBER:
            if (!lua_isnumber(LUA, argno)) {
                snprintf(s_arg_error, sizeof(s_arg_error),
                         "arg #%d: expected number, got %s",
                         argno, luaL_typename(LUA, argno));
                return 1;
            }
            *(float *)out = lua_tonumber(LUA, argno);
            break;
        case LOCAL_LUA_STRING:
            if (!lua_isstring(LUA, argno)) {
                snprintf(s_arg_error, sizeof(s_arg_error),
                         "arg #%d: expected string, got %s",
                         argno, luaL_typename(LUA, argno));
                return 1;
            }
            *(const char **)out = lua_tostring(LUA, argno);
            break;
    }
    return 0;
}

// Macro to get arg with automatic error handling
// Usage: LUA_ARG(L, 1, LOCAL_LUA_INTEGER, x, "function_name");
#define LUA_ARG(L, argno, type, var, funcname) \
    do { \
        if (get_lua_arg(L, argno, type, &(var))) { \
            return luaL_error(L, "%s: %s", funcname, s_arg_error); \
        } \
    } while(0)

int lua_fill_rect(lua_State *LUA) {
    int x, y, w, h, r, g, b;
    LUA_ARG(LUA, 1, LOCAL_LUA_INTEGER, x, "fill_rect");
    LUA_ARG(LUA, 2, LOCAL_LUA_INTEGER, y, "fill_rect");
    LUA_ARG(LUA, 3, LOCAL_LUA_INTEGER, w, "fill_rect");
    LUA_ARG(LUA, 4, LOCAL_LUA_INTEGER, h, "fill_rect");
    LUA_ARG(LUA, 5, LOCAL_LUA_INTEGER, r, "fill_rect");
    LUA_ARG(LUA, 6, LOCAL_LUA_INTEGER, g, "fill_rect");
    LUA_ARG(LUA, 7, LOCAL_LUA_INTEGER, b, "fill_rect");
    fill_rect(x, y, w, h, r, g, b);
    return 0;
}

int lua_set_pixel(lua_State *LUA) {
    int x, y, r, g, b;
    LUA_ARG(LUA, 1, LOCAL_LUA_INTEGER, x, "set_pixel");
    LUA_ARG(LUA, 2, LOCAL_LUA_INTEGER, y, "set_pixel");
    LUA_ARG(LUA, 3, LOCAL_LUA_INTEGER, r, "set_pixel");
    LUA_ARG(LUA, 4, LOCAL_LUA_INTEGER, g, "set_pixel");
    LUA_ARG(LUA, 5, LOCAL_LUA_INTEGER, b, "set_pixel");
    set_pixel(x, y, r, g, b);
    return 0;
}

int lua_draw_hline(lua_State *LUA) {
    int x, y, len, r, g, b;
    LUA_ARG(LUA, 1, LOCAL_LUA_INTEGER, x, "draw_hline");
    LUA_ARG(LUA, 2, LOCAL_LUA_INTEGER, y, "draw_hline");
    LUA_ARG(LUA, 3, LOCAL_LUA_INTEGER, len, "draw_hline");
    LUA_ARG(LUA, 4, LOCAL_LUA_INTEGER, r, "draw_hline");
    LUA_ARG(LUA, 5, LOCAL_LUA_INTEGER, g, "draw_hline");
    LUA_ARG(LUA, 6, LOCAL_LUA_INTEGER, b, "draw_hline");
    horiz_line(x, y, len, r, g, b);
    return 0;
}

int lua_draw_vline(lua_State *LUA) {
    int x, y, len, r, g, b;
    LUA_ARG(LUA, 1, LOCAL_LUA_INTEGER, x, "draw_vline");
    LUA_ARG(LUA, 2, LOCAL_LUA_INTEGER, y, "draw_vline");
    LUA_ARG(LUA, 3, LOCAL_LUA_INTEGER, len, "draw_vline");
    LUA_ARG(LUA, 4, LOCAL_LUA_INTEGER, r, "draw_vline");
    LUA_ARG(LUA, 5, LOCAL_LUA_INTEGER, g, "draw_vline");
    LUA_ARG(LUA, 6, LOCAL_LUA_INTEGER, b, "draw_vline");
    vert_line(x, y, len, r, g, b);
    return 0;
}

int lua_clear_display(lua_State *LUA) {
    (void)LUA;
    clear_display();
    return 0;
}

// Bresenham's line algorithm
static void draw_line_impl(int x0, int y0, int x1, int y1, int r, int g, int b) {
    int dx = abs(x1 - x0);
    int dy = -abs(y1 - y0);
    int sx = x0 < x1 ? 1 : -1;
    int sy = y0 < y1 ? 1 : -1;
    int err = dx + dy;

    while (1) {
        set_pixel(x0, y0, r, g, b);
        if (x0 == x1 && y0 == y1) break;
        int e2 = 2 * err;
        if (e2 >= dy) {
            err += dy;
            x0 += sx;
        }
        if (e2 <= dx) {
            err += dx;
            y0 += sy;
        }
    }
}

int lua_draw_line(lua_State *LUA) {
    int x0, y0, x1, y1, r, g, b;
    LUA_ARG(LUA, 1, LOCAL_LUA_INTEGER, x0, "draw_line");
    LUA_ARG(LUA, 2, LOCAL_LUA_INTEGER, y0, "draw_line");
    LUA_ARG(LUA, 3, LOCAL_LUA_INTEGER, x1, "draw_line");
    LUA_ARG(LUA, 4, LOCAL_LUA_INTEGER, y1, "draw_line");
    LUA_ARG(LUA, 5, LOCAL_LUA_INTEGER, r, "draw_line");
    LUA_ARG(LUA, 6, LOCAL_LUA_INTEGER, g, "draw_line");
    LUA_ARG(LUA, 7, LOCAL_LUA_INTEGER, b, "draw_line");
    draw_line_impl(x0, y0, x1, y1, r, g, b);
    return 0;
}

// Midpoint circle algorithm
int lua_draw_circle(lua_State *LUA) {
    int cx, cy, radius, r, g, b;
    LUA_ARG(LUA, 1, LOCAL_LUA_INTEGER, cx, "draw_circle");
    LUA_ARG(LUA, 2, LOCAL_LUA_INTEGER, cy, "draw_circle");
    LUA_ARG(LUA, 3, LOCAL_LUA_INTEGER, radius, "draw_circle");
    LUA_ARG(LUA, 4, LOCAL_LUA_INTEGER, r, "draw_circle");
    LUA_ARG(LUA, 5, LOCAL_LUA_INTEGER, g, "draw_circle");
    LUA_ARG(LUA, 6, LOCAL_LUA_INTEGER, b, "draw_circle");

    int x = radius;
    int y = 0;
    int d = 1 - radius;

    while (x >= y) {
        set_pixel(cx + x, cy + y, r, g, b);
        set_pixel(cx - x, cy + y, r, g, b);
        set_pixel(cx + x, cy - y, r, g, b);
        set_pixel(cx - x, cy - y, r, g, b);
        set_pixel(cx + y, cy + x, r, g, b);
        set_pixel(cx - y, cy + x, r, g, b);
        set_pixel(cx + y, cy - x, r, g, b);
        set_pixel(cx - y, cy - x, r, g, b);

        y++;
        if (d < 0) {
            d += 2 * y + 1;
        } else {
            x--;
            d += 2 * (y - x) + 1;
        }
    }
    return 0;
}

// Filled circle using horizontal lines
int lua_draw_filled_circle(lua_State *LUA) {
    int cx, cy, radius, r, g, b;
    LUA_ARG(LUA, 1, LOCAL_LUA_INTEGER, cx, "draw_filled_circle");
    LUA_ARG(LUA, 2, LOCAL_LUA_INTEGER, cy, "draw_filled_circle");
    LUA_ARG(LUA, 3, LOCAL_LUA_INTEGER, radius, "draw_filled_circle");
    LUA_ARG(LUA, 4, LOCAL_LUA_INTEGER, r, "draw_filled_circle");
    LUA_ARG(LUA, 5, LOCAL_LUA_INTEGER, g, "draw_filled_circle");
    LUA_ARG(LUA, 6, LOCAL_LUA_INTEGER, b, "draw_filled_circle");

    int x = radius;
    int y = 0;
    int d = 1 - radius;

    while (x >= y) {
        horiz_line(cx - x, cy + y, 2 * x + 1, r, g, b);
        horiz_line(cx - x, cy - y, 2 * x + 1, r, g, b);
        horiz_line(cx - y, cy + x, 2 * y + 1, r, g, b);
        horiz_line(cx - y, cy - x, 2 * y + 1, r, g, b);

        y++;
        if (d < 0) {
            d += 2 * y + 1;
        } else {
            x--;
            d += 2 * (y - x) + 1;
        }
    }
    return 0;
}

// Triangle outline using three lines
int lua_draw_triangle(lua_State *LUA) {
    int x0, y0, x1, y1, x2, y2, r, g, b;
    LUA_ARG(LUA, 1, LOCAL_LUA_INTEGER, x0, "draw_triangle");
    LUA_ARG(LUA, 2, LOCAL_LUA_INTEGER, y0, "draw_triangle");
    LUA_ARG(LUA, 3, LOCAL_LUA_INTEGER, x1, "draw_triangle");
    LUA_ARG(LUA, 4, LOCAL_LUA_INTEGER, y1, "draw_triangle");
    LUA_ARG(LUA, 5, LOCAL_LUA_INTEGER, x2, "draw_triangle");
    LUA_ARG(LUA, 6, LOCAL_LUA_INTEGER, y2, "draw_triangle");
    LUA_ARG(LUA, 7, LOCAL_LUA_INTEGER, r, "draw_triangle");
    LUA_ARG(LUA, 8, LOCAL_LUA_INTEGER, g, "draw_triangle");
    LUA_ARG(LUA, 9, LOCAL_LUA_INTEGER, b, "draw_triangle");
    draw_line_impl(x0, y0, x1, y1, r, g, b);
    draw_line_impl(x1, y1, x2, y2, r, g, b);
    draw_line_impl(x2, y2, x0, y0, r, g, b);
    return 0;
}

// Filled triangle using scanline algorithm
static void swap_int(int *a, int *b) {
    int t = *a; *a = *b; *b = t;
}

int lua_draw_filled_triangle(lua_State *LUA) {
    int x0, y0, x1, y1, x2, y2, r, g, b;
    LUA_ARG(LUA, 1, LOCAL_LUA_INTEGER, x0, "draw_filled_triangle");
    LUA_ARG(LUA, 2, LOCAL_LUA_INTEGER, y0, "draw_filled_triangle");
    LUA_ARG(LUA, 3, LOCAL_LUA_INTEGER, x1, "draw_filled_triangle");
    LUA_ARG(LUA, 4, LOCAL_LUA_INTEGER, y1, "draw_filled_triangle");
    LUA_ARG(LUA, 5, LOCAL_LUA_INTEGER, x2, "draw_filled_triangle");
    LUA_ARG(LUA, 6, LOCAL_LUA_INTEGER, y2, "draw_filled_triangle");
    LUA_ARG(LUA, 7, LOCAL_LUA_INTEGER, r, "draw_filled_triangle");
    LUA_ARG(LUA, 8, LOCAL_LUA_INTEGER, g, "draw_filled_triangle");
    LUA_ARG(LUA, 9, LOCAL_LUA_INTEGER, b, "draw_filled_triangle");

    // Sort vertices by y-coordinate (y0 <= y1 <= y2)
    if (y0 > y1) { swap_int(&y0, &y1); swap_int(&x0, &x1); }
    if (y1 > y2) { swap_int(&y1, &y2); swap_int(&x1, &x2); }
    if (y0 > y1) { swap_int(&y0, &y1); swap_int(&x0, &x1); }

    if (y0 == y2) {
        // Degenerate case - horizontal line
        int minx = x0 < x1 ? (x0 < x2 ? x0 : x2) : (x1 < x2 ? x1 : x2);
        int maxx = x0 > x1 ? (x0 > x2 ? x0 : x2) : (x1 > x2 ? x1 : x2);
        horiz_line(minx, y0, maxx - minx + 1, r, g, b);
        return 0;
    }

    // Fill using horizontal lines
    for (int y = y0; y <= y2; y++) {
        int xa, xb;

        if (y < y1) {
            // Upper part of triangle
            xa = x0 + (x1 - x0) * (y - y0) / (y1 - y0);
            xb = x0 + (x2 - x0) * (y - y0) / (y2 - y0);
        } else {
            // Lower part of triangle
            if (y1 == y2) {
                xa = x1;
            } else {
                xa = x1 + (x2 - x1) * (y - y1) / (y2 - y1);
            }
            xb = x0 + (x2 - x0) * (y - y0) / (y2 - y0);
        }

        if (xa > xb) swap_int(&xa, &xb);
        horiz_line(xa, y, xb - xa + 1, r, g, b);
    }
    return 0;
}

// 3x3 bitmap font for ASCII 32-126 (minimal, best for digits)
static const uint8_t font3x3[95][3] = {
    {0x0,0x0,0x0}, // 32 (space)
    {0x2,0x2,0x2}, // 33 !
    {0x5,0x0,0x0}, // 34 "
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    {0x5,0x2,0x0}, // 126 ~
};

// 5x5 bitmap font for ASCII 32-126
static const uint8_t font5x5[95][5] = {
    {0x00,0x00,0x00,0x00,0x00}, // 32 (space)
    {0x04,0x04,0x04,0x00,0x04}, // 33 !
    {0x0A,0x0A,0x00,0x00,0x00}, // 34 "
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    {0x00,0x0D,0x12,0x00,0x00}, // 126 ~
};

// 8x8 bitmap font for ASCII 32-126
static const uint8_t font8x8[95][8] = {
    {0x00,0x00,0x00,0x00,0x00,0x00,0x00,0x00}, // 32 (space)
    {0x18,0x3C,0x3C,0x18,0x18,0x00,0x18,0x00}, // 33 !
    {0x36,0x36,0x00,0x00,0x00,0x00,0x00,0x00}, // 34 "
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    {0x6E,0x3B,0x00,0x00,0x00,0x00,0x00,0x00}, // 126 ~
};

// 16x16 bitmap font for ASCII 32-126
static const uint16_t font16x16[95][16] = {
    {0x0000,0x0000,0x0000,0x0000,0x0000,0x0000,0x0000,0x0000,0x0000,0x0000,0x0000,0x0000,0x0000,0x0000,0x0000,0x0000}, // 32 (space)
    {0x0180,0x0180,0x0180,0x0180,0x0180,0x0180,0x0180,0x0180,0x0180,0x0180,0x0000,0x0000,0x0180,0x0180,0x0000,0x0000}, // 33 !
    {0x0660,0x0660,0x0660,0x0660,0x0000,0x0000,0x0000,0x0000,0x0000,0x0000,0x0000,0x0000,0x0000,0x0000,0x0000,0x0000}, // 34 "
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    {0x0000,0x0000,0x0000,0x0000,0x0000,0x0000,0x18F0,0x1FF8,0x0F18,0x0000,0x0000,0x0000,0x0000,0x0000,0x0000,0x0000}, // 126 ~
};

static void draw_char_sized(int x, int y, char c, int r, int g, int b, int size) {
    if (c < 32 || c > 126) c = '?';
    int idx = c - 32;

    if (size == 3) {
        const uint8_t *glyph = font3x3[idx];
        for (int row = 0; row < 3; row++) {
            uint8_t bits = glyph[row];
            for (int col = 0; col < 3; col++) {
                if (bits & (1 << col)) {
                    set_pixel(x + col, y + row, r, g, b);
                }
            }
        }
    } else if (size == 5) {
        const uint8_t *glyph = font5x5[idx];
        for (int row = 0; row < 5; row++) {
            uint8_t bits = glyph[row];
            for (int col = 0; col < 5; col++) {
                if (bits & (1 << col)) {
                    set_pixel(x + col, y + row, r, g, b);
                }
            }
        }
    } else if (size == 16) {
        const uint16_t *glyph = font16x16[idx];
        for (int row = 0; row < 16; row++) {
            uint16_t bits = glyph[row];
            for (int col = 0; col < 16; col++) {
                if (bits & (1 << col)) {
                    set_pixel(x + col, y + row, r, g, b);
                }
            }
        }
    } else {
        // Default to 8x8
        const uint8_t *glyph = font8x8[idx];
        for (int row = 0; row < 8; row++) {
            uint8_t bits = glyph[row];
            for (int col = 0; col < 8; col++) {
                if (bits & (1 << col)) {
                    set_pixel(x + col, y + row, r, g, b);
                }
            }
        }
    }
}

int lua_draw_string(lua_State *LUA) {
    int x, y, r, g, b, size = 8;
    int nargs = lua_gettop(LUA);
    const char *str;

    // Arg 1: string
    LUA_ARG(LUA, 1, LOCAL_LUA_STRING, str, "draw_string");

    // Args 2-6: x, y, r, g, b
    LUA_ARG(LUA, 2, LOCAL_LUA_INTEGER, x, "draw_string");
    LUA_ARG(LUA, 3, LOCAL_LUA_INTEGER, y, "draw_string");
    LUA_ARG(LUA, 4, LOCAL_LUA_INTEGER, r, "draw_string");
    LUA_ARG(LUA, 5, LOCAL_LUA_INTEGER, g, "draw_string");
    LUA_ARG(LUA, 6, LOCAL_LUA_INTEGER, b, "draw_string");

    // Optional font size parameter (default 8)
    if (nargs >= 7 && lua_isinteger(LUA, 7)) {
        size = lua_tointeger(LUA, 7);
        // Validate size - only allow 3, 5, 8, or 16
        if (size != 3 && size != 5 && size != 8 && size != 16) {
            size = 8;
        }
    }

    int cursor_x = x;
    // Add 1 pixel spacing between characters
    int char_width = (size == 3) ? 4 : (size == 5) ? 6 : (size == 16) ? 17 : 9;
    while (*str) {
        draw_char_sized(cursor_x, y, *str, r, g, b, size);
        cursor_x += char_width;
        str++;
    }
    return 0;
}

// C-callable text drawing function for boot screen etc.
void draw_text(const char *str, int x, int y, int r, int g, int b, int size) {
    // Validate size
    if (size != 3 && size != 5 && size != 8 && size != 16) {
        size = 8;
    }

    int cursor_x = x;
    int char_width = (size == 3) ? 4 : (size == 5) ? 6 : (size == 16) ? 17 : 9;
    while (*str) {
        draw_char_sized(cursor_x, y, *str, r, g, b, size);
        cursor_x += char_width;
        str++;
    }
}

int lua_millis(lua_State *LUA) {
    uint64_t usec = (int)esp_timer_get_time();
    uint32_t millis = usec / 1000;
    lua_pushinteger(LUA,millis);
    return 1;
}

int lua_delay(lua_State *LUA) {
    int ms;
    LUA_ARG(LUA, 1, LOCAL_LUA_INTEGER, ms, "delay");
    if (ms > 0) {
        vTaskDelay(pdMS_TO_TICKS(ms));
    }
    return 0;
}

// mqtt_connected() - returns true if MQTT is connected
int lua_mqtt_connected(lua_State *LUA) {
    lua_pushboolean(LUA, mqtt_client_is_connected());
    return 1;
}

// mqtt_publish(topic, message, [qos], [retain]) - publish a message
int lua_mqtt_publish(lua_State *LUA) {
    int nargs = lua_gettop(LUA);
    if (nargs < 2) {
        lua_pushliteral(LUA, "mqtt_publish requires topic and message");
        lua_error(LUA);
        return 0;
    }

    const char *topic = lua_tostring(LUA, 1);
    const char *message = lua_tostring(LUA, 2);
    int qos = (nargs >= 3) ? lua_tointeger(LUA, 3) : 0;
    int retain = (nargs >= 4) ? lua_toboolean(LUA, 4) : 0;

    esp_err_t err = mqtt_publish(topic, message, qos, retain);
    lua_pushboolean(LUA, err == ESP_OK);
    return 1;
}

// mqtt_receive() - non-blocking check for pending messages
// Returns: topic, message if available; nil if no message
int lua_mqtt_receive(lua_State *LUA) {
    char topic[128], data[512];
    if (mqtt_get_pending_message(topic, sizeof(topic), data, sizeof(data))) {
        lua_pushstring(LUA, topic);
        lua_pushstring(LUA, data);
        return 2;
    }
    lua_pushnil(LUA);
    return 1;
}

// mqtt_wait([timeout_ms]) - blocking wait for message
// Returns: topic, message if received; nil if timeout
// timeout_ms: 0 or omitted = wait forever
int lua_mqtt_wait(lua_State *LUA) {
    uint32_t timeout_ms = 0;
    if (lua_gettop(LUA) >= 1 && lua_isinteger(LUA, 1)) {
        timeout_ms = lua_tointeger(LUA, 1);
    }

    char topic[128], data[512];
    if (mqtt_wait_for_message(topic, sizeof(topic), data, sizeof(data), timeout_ms)) {
        lua_pushstring(LUA, topic);
        lua_pushstring(LUA, data);
        return 2;
    }
    lua_pushnil(LUA);
    return 1;
}

// http_fetch(url) - fetch content from HTTP server
// url format: "hostname:port/path" or "hostname/path" or "hostname:port" or "hostname"
// Returns: response body as string, or nil on error
#define HTTP_FETCH_MAX_SIZE 8192

int lua_http_fetch(lua_State *LUA) {
    if (lua_gettop(LUA) < 1 || !lua_isstring(LUA, 1)) {
        lua_pushliteral(LUA, "http_fetch requires a URL string");
        lua_error(LUA);
        return 0;
    }

    const char *url_arg = lua_tostring(LUA, 1);

    // Build the full URL with http:// prefix if needed
    char url[512];
    if (strncmp(url_arg, "http://", 7) == 0 || strncmp(url_arg, "https://", 8) == 0) {
        snprintf(url, sizeof(url), "%s", url_arg);
    } else {
        snprintf(url, sizeof(url), "http://%s", url_arg);
    }

    ESP_LOGI(TAG, "http_fetch: %s", url);

    esp_http_client_config_t config = {
        .url = url,
        .timeout_ms = 10000,
    };

    esp_http_client_handle_t client = esp_http_client_init(&config);
    if (client == NULL) {
        ESP_LOGE(TAG, "Failed to init HTTP client");
        lua_pushnil(LUA);
        return 1;
    }

    esp_err_t err = esp_http_client_open(client, 0);
    if (err != ESP_OK) {
        ESP_LOGE(TAG, "Failed to open HTTP connection: %s", esp_err_to_name(err));
        esp_http_client_cleanup(client);
        lua_pushnil(LUA);
        return 1;
    }

    int content_length = esp_http_client_fetch_headers(client);
    if (content_length < 0) {
        content_length = HTTP_FETCH_MAX_SIZE; // Unknown length, try to read up to max
    }

    // Limit to max size
    if (content_length > HTTP_FETCH_MAX_SIZE) {
        content_length = HTTP_FETCH_MAX_SIZE;
    }

    char *buffer = malloc(content_length + 1);
    if (buffer == NULL) {
        ESP_LOGE(TAG, "Failed to allocate buffer for HTTP response");
        esp_http_client_close(client);
        esp_http_client_cleanup(client);
        lua_pushnil(LUA);
        return 1;
    }

    int total_read = 0;
    int read_len;
    while (total_read < content_length) {
        read_len = esp_http_client_read(client, buffer + total_read, content_length - total_read);
        if (read_len <= 0) {
            break;
        }
        total_read += read_len;
    }
    buffer[total_read] = '\0';

    int status = esp_http_client_get_status_code(client);
    ESP_LOGI(TAG, "HTTP status: %d, read %d bytes", status, total_read);

    esp_http_client_close(client);
    esp_http_client_cleanup(client);

    if (status >= 200 && status < 300) {
        lua_pushstring(LUA, buffer);
    } else {
        ESP_LOGE(TAG, "HTTP request failed with status %d", status);
        lua_pushnil(LUA);
    }

    free(buffer);
    return 1;
}

void load_lua_funcs(lua_State *LUA) {
    lua_register(LUA, "clear_display", lua_clear_display);
    lua_register(LUA, "fill_rect", lua_fill_rect);
    lua_register(LUA, "draw_hline", lua_draw_hline);
    lua_register(LUA, "draw_vline", lua_draw_vline);
    lua_register(LUA, "set_pixel", lua_set_pixel);
    lua_register(LUA, "draw_line", lua_draw_line);
    lua_register(LUA, "draw_circle", lua_draw_circle);
    lua_register(LUA, "draw_filled_circle", lua_draw_filled_circle);
    lua_register(LUA, "draw_triangle", lua_draw_triangle);
    lua_register(LUA, "draw_filled_triangle", lua_draw_filled_triangle);
    lua_register(LUA, "draw_string", lua_draw_string);
    lua_register(LUA, "millis", lua_millis);
    lua_register(LUA, "delay", lua_delay);
    lua_register(LUA, "mqtt_connected", lua_mqtt_connected);
    lua_register(LUA, "mqtt_publish", lua_mqtt_publish);
    lua_register(LUA, "mqtt_receive", lua_mqtt_receive);
    lua_register(LUA, "mqtt_wait", lua_mqtt_wait);
    lua_register(LUA, "http_fetch", lua_http_fetch);
}